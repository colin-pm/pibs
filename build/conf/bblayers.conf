## build/conf/bblayers.conf
```bitbake
# POKY_BBLAYERS_CONF_VERSION is increased each time build/conf/bblayers.conf
# changes incompatibly
POKY_BBLAYERS_CONF_VERSION = "2"

BBPATH = "${TOPDIR}"
BBFILES ?= ""

BBLAYERS ?= " \
  /home/colin/yocto/pibs/poky/meta \
  /home/colin/yocto/pibs/poky/meta-poky \
  /home/colin/yocto/pibs/poky/meta-yocto-bsp \
  "
```
